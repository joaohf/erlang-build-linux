## meta-erlang-build/conf/layer.conf
```bitbake
# We have a conf and classes directory, add to BBPATH
BBPATH .= ":${LAYERDIR}"

# We have recipes-* directories, add to BBFILES
BBFILES += "${LAYERDIR}/recipes-*/*/*.bb \
            ${LAYERDIR}/recipes-*/*/*.bbappend"

BBFILE_COLLECTIONS += "meta-erlang-build"
BBFILE_PATTERN_meta-erlang-build = "^${LAYERDIR}/"
BBFILE_PRIORITY_meta-erlang-build = "6"

LAYERDEPENDS_meta-erlang-build = "core"
LAYERSERIES_COMPAT_meta-erlang-build = "scarthgap"
```
